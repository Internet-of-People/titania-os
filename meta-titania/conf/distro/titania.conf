## meta-titania/conf/distro/titania.conf
```bitbake
DISTRO = "titania"
DISTRO_NAME = "TitaniaOS"
DISTRO_VERSION_MAJOR ?= "1"
DISTRO_VERSION_MINOR ?= "1"
DISTRO_VERSION_PATCH ?= "2"

# Override if you need an RC or something like that
# NOTE: add the hyphen on your own, e.g. "-rc5"
DISTRO_VERSION_EXT ?= ""

DISTRO_VERSION ?= "${DISTRO_VERSION_MAJOR}.${DISTRO_VERSION_MINOR}.${DISTRO_VERSION_PATCH}${DISTRO_VERSION_EXT}"

DISTRO_CODENAME = "naphal"

MAINTAINER = "Laszlo Megyer <laszlo.megyer@iop-ventures.com>"

# Additional packages
TITANIA_FEATURES = "systemd"
DISTRO_FEATURES ?= "${DISTRO_FEATURES_DEFAULT} ${DISTRO_FEATURES_LIBC} ${TITANIA_FEATURES}"

# We don't need X11
DISTRO_FEATURES_remove = "x11"

# Switch to Systemd, remove the default init
VIRTUAL-RUNTIME_init_manager = "systemd"
# TODO: this is supposed to kill init scripts but it doesn't quite
VIRTUAL-RUNTIME_initscripts = ""
DISTRO_FEATURES_BACKFILL_CONSIDERED = "sysvinit"

# Additional target that runs update-check and other "after everything" units
SYSTEMD_DEFAULT_TARGET = "after-everything.target"

# Persistent files and directories that are carried with updates
# Recipes can edit those
# PERSISTENT_FILES ?= ""
# PERSISTENT_DIRS ?= ""

# TODO: (see poky.conf)
# - vardepsexclude
# - TARGET_VENDOR
```

## meta-titania/conf/layer.conf
```bitbake
# Include local stuff as a layer
BBPATH =. "${LAYERDIR}:"
BBFILE_COLLECTIONS += "titania"
BBFILE_PATTERN_titania = "^${LAYERDIR}/"
BBFILES += "${LAYERDIR}/recipes-*/*/*.bb \
            ${LAYERDIR}/recipes-*/*/*.bbappend"

# Should be higher than systemd
BBFILE_PRIORITY_titania = "10"

# Restrict Yocto releases compatible to support RPi 3B+
LAYERSERIES_COMPAT_titania = "sumo"

# Weak default origin to pull from GitHub
# Override in a local config or per-recipe
LIBERTARIA_GIT_ORIGIN ??= "https://github.com/libertaria-project"
LIBERTARIA_GIT_PROTOCOL ??= "${@ "https" if d.getVar('LIBERTARIA_GIT_ORIGIN')[:8]=="https://" else "ssh" }"

# Fix http:// URLs to git://, also add it to the ones missing the scheme altogether
# Direct assignment, no defaults, __import__ magic because it's a lambda
LIBERTARIA_GIT_PREFIX = "${@ __import__('re').sub(r"^((https|git)://)?", "git://", d.getVar('LIBERTARIA_GIT_ORIGIN')) }"
```

## meta-titania/conf/machine/raspberrypi3.conf
```bitbake
#@TYPE: Machine
#@NAME: RaspberryPi 3 Development Board
#@DESCRIPTION: Machine configuration for the RaspberryPi 3

DEFAULTTUNE ?= "cortexa7thf-neon-vfpv4"
require conf/machine/include/tune-cortexa7.inc
include conf/machine/include/rpi-base.inc

MACHINE_EXTRA_RRECOMMENDS += "\
    linux-firmware-bcm43430 \
    linux-firmware-bcm43455 \
    linux-firmware-bcm43430a1-hcd \
    linux-firmware-bcm4345c0-hcd \
"

SDIMG_KERNELIMAGE ?= "kernel7.img"
UBOOT_MACHINE = "rpi_3_32b_config"
SERIAL_CONSOLE ?= "115200 ttyS0"
VC4_CMA_SIZE ?= "cma-256"

# Titania customizations:
RPI_USE_U_BOOT = "1"
KERNEL_DEVICETREE = "bcm2710-rpi-3-b-plus.dtb bcm2710-rpi-3-b.dtb"
SKIP_META_VIRT_SANITY_CHECK = "1"
HWREVISION = "raspberrypi 3"
IMAGE_BOOT_FILES = "bcm2835-bootfiles/*  uImage-bcm2710-rpi-3-b-plus.dtb;bcm2710-rpi-3-b-plus.dtb  uImage-bcm2710-rpi-3-b.dtb;bcm2710-rpi-3-b.dtb  uImage;uImage_a  u-boot.bin;kernel7.img  boot.scr"
```

## meta-titania/wic/lezimg.wks
```
# Titania partition layout.
# Currently it is x86 only, as rpi has some custom steps when bootloader related files, overlays and dtds get on the firmware.
# Also, x86 root doesn't fit into 512M, so it's increased to 1024M.

# Boot partition
part /boot --source bootimg-pcbios --ondisk sda --fstype=vfat --label boot --active --align 4096 --fixed-size 40M --extra-space 0

# Root "A" partition
part / --source rootfs --ondisk sda --fstype=ext4 --label root_a --align 4096 --fixed-size 1024M

# Root "B" partition (not mounted)
part   --source rootfs --ondisk sda --fstype=ext4 --label root_b --align 4096 --fixed-size 1024M

# User data partition
part /datafs --source rawcopy --sourceparams="file=titania-datafs-image-qemux86-64.ext4" --ondisk sda --label data --align 4096 --fixed-size 1024M


bootloader --timeout=0  --append="rw rootfstype=ext4 root=/dev/hda2"
```

## meta-titania/wic/titania-rpi.wks
```
# Titania partition layout.

# Boot partition
part /boot --source bootimg-partition --ondisk mmcblk0 --fstype=vfat --label BOOT --active --align 4096 --fixed-size 40M --extra-space 0

# Root "A" partition
part / --source rootfs --ondisk mmcblk0 --fstype=ext4 --label root_a --align 4096 --fixed-size 504M

# Root "B" partition (not mounted)
part   --source rootfs --ondisk mmcblk0 --fstype=ext4 --label root_b --align 4096 --fixed-size 504M

# User data partition
part /datafs --source rawcopy --sourceparams="file=titania-datafs-image-raspberrypi3.ext4" --ondisk mmcblk0 --fstype=ext4 --align 4096 --fixed-size 448M
```
